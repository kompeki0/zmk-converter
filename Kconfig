## Kconfig
```kconfig
menu "BLE HOGP Sniffer"

config ZMK_BLE_HOGP_SNIFFER
    bool "Enable BLE HOGP sniffer"
    depends on BT && BT_CENTRAL && BT_OBSERVER && BT_GATT_CLIENT
    help
      Connect to a fixed BLE HID keyboard and subscribe to HID Input
      Report notifications, then print incoming reports in logs.

config ZMK_BLE_HOGP_SNIFFER_TARGET_MAC
    string "Target MAC address"
    depends on ZMK_BLE_HOGP_SNIFFER
    default "dd:75:7b:9c:8a:1f"
    help
      Target device address in xx:xx:xx:xx:xx:xx format.

config ZMK_BLE_HOGP_SNIFFER_TARGET_ADDR_TYPE_PUBLIC
    bool "Target address type is public"
    depends on ZMK_BLE_HOGP_SNIFFER
    default n
    help
      If disabled, target address type is treated as random/static random.

config ZMK_BLE_HOGP_SNIFFER_LOG_LEVEL
    int "Log level"
    depends on ZMK_BLE_HOGP_SNIFFER
    range 0 4
    default 3
    help
      0=OFF, 1=ERR, 2=WRN, 3=INF, 4=DBG.

config ZMK_BLE_HOGP_SNIFFER_LOG_SCAN_EVENTS
    bool "Log all scan events"
    depends on ZMK_BLE_HOGP_SNIFFER
    default y
    help
      Log every received advertising packet address/type/RSSI while scanning.

config ZMK_BLE_HOGP_SNIFFER_REQUIRE_HIDS_IN_ADV
    bool "Require HID service UUID (0x1812) in advertising data before connect"
    depends on ZMK_BLE_HOGP_SNIFFER
    default y
    help
      Only connect when the target MAC packet contains HID Service UUID
      (0x1812) in UUID16 AD fields. This helps avoid connecting to split-side
      non-HID endpoints that share nearby traffic.

config ZMK_BLE_HOGP_SNIFFER_REJECT_SPLIT_UUID_IN_ADV
    bool "Reject advertisements containing ZMK split service UUID"
    depends on ZMK_BLE_HOGP_SNIFFER
    default y
    help
      Skip connection attempts when target MAC advertisement contains
      ZMK split BLE service UUID. Useful when HIDS-in-ADV requirement is
      disabled but you still want to avoid connecting to split-side links.

config ZMK_BLE_HOGP_SNIFFER_SCAN_CYCLE_MS
    int "Scan cycle duration before attempting connect (ms)"
    depends on ZMK_BLE_HOGP_SNIFFER
    range 200 10000
    default 3000
    help
      Duration of one scan cycle. During this period, matching candidates are
      collected and the connection attempt is made after the cycle ends.

config ZMK_BLE_HOGP_SNIFFER_NEXT_CONNECT_DELAY_MS
    int "Delay before trying next candidate after disconnect (ms)"
    depends on ZMK_BLE_HOGP_SNIFFER
    range 50 3000
    default 300
    help
      Wait time before next connection attempt when stepping through
      candidates after disconnect/failure. Helps avoid bt_conn_le_create
      failing while the previous link is still tearing down.

config ZMK_BLE_HOGP_SNIFFER_SINGLE_TARGET_ONLY
    bool "After HID is verified, reconnect only to the single target"
    depends on ZMK_BLE_HOGP_SNIFFER
    default y
    help
      If enabled, once HID reports are successfully subscribed, candidate
      list traversal is disabled and reconnect flow always targets only the
      configured target MAC.

config ZMK_BLE_HOGP_SNIFFER_FORWARD_KEY_EVENTS
    bool "Forward keyboard usages as ZMK key events"
    depends on ZMK_BLE_HOGP_SNIFFER
    default y
    help
      Parse standard 8-byte keyboard input reports and emit press/release
      events through ZMK so the board can output to the host.

config ZMK_BLE_HOGP_SNIFFER_EMIT_POSITION_EVENTS
    bool "Emit virtual kscan events (positions) for keymap remapping"
    depends on ZMK_BLE_HOGP_SNIFFER
    default y
    help
      Convert incoming HID keyboard usages into virtual matrix row/col events
      so they flow through the normal ZMK keymap/behavior pipeline.

config ZMK_BLE_HOGP_SNIFFER_CLEAR_NON_TARGET_BONDS_ON_START
    bool "Clear all BLE bonds except target keyboard on boot"
    depends on ZMK_BLE_HOGP_SNIFFER
    default y
    help
      Remove non-target bonds at startup while preserving the fixed target
      keyboard bond. Useful for re-pairing with host PCs without resetting
      the keyboard link.

config ZMK_BLE_HOGP_SNIFFER_CLEAR_TARGET_BOND_ON_START
    bool "Clear target keyboard bond on boot"
    depends on ZMK_BLE_HOGP_SNIFFER
    default n
    help
      Clear the target keyboard bond on startup. Enable temporarily when
      keyboard pairing gets stuck, then disable again.

config ZMK_BLE_HOGP_SNIFFER_SELFTEST_TYPE_TESTING_ON_BOOT
    bool "Type 'testing' to host a few seconds after boot (debug)"
    depends on ZMK_BLE_HOGP_SNIFFER
    depends on ZMK_BLE_HOGP_SNIFFER_FORWARD_KEY_EVENTS
    default n
    help
      After boot, when an output endpoint is connected, emit key events to type
      the string 'testing'. This is for quickly confirming host connectivity.

config ZMK_BLE_HOGP_SNIFFER_BLOCK_HOST_ADV_UNTIL_TARGET_CONNECTED
    bool "Block host BLE advertising until target keyboard is connected"
    depends on ZMK_BLE_HOGP_SNIFFER
    depends on ZMK_BLE
    default y
    help
      Stop ZMK's peripheral advertising while waiting for the fixed target
      keyboard connection. Once connected, advertising is resumed so a PC can
      pair/connect.

config ZMK_BLE_HOGP_SNIFFER_BUTTON_SELECTOR
    bool "Enable 4-button target selector (Up/Down/OK/Back)"
    depends on ZMK_BLE_HOGP_SNIFFER
    default y
    help
      Use external buttons to choose the target keyboard from discovered
      candidate names (alnum), then connect/disconnect.
      If disabled, the sniffer uses fixed target MAC settings
      (CONFIG_ZMK_BLE_HOGP_SNIFFER_TARGET_MAC / ADDR_TYPE_PUBLIC).

config ZMK_BLE_HOGP_SNIFFER_WAIT_FOR_HOST_BEFORE_TARGET_SCAN
    bool "Wait host-PC connection before scanning target keyboard"
    depends on ZMK_BLE_HOGP_SNIFFER
    default n
    help
      If enabled, keep host BLE advertising active and defer target keyboard
      scanning until a host PC is connected to this device.

endmenu

config ZMK_PROXY_FACTORY_RESET_ON_BOOT
    bool "Factory reset storage partition on boot (one-shot)"
    depends on BT
    depends on FLASH_MAP
    default n
    help
      One-shot maintenance mode. On boot, unpair all BLE peers and erase the
      storage partition used by settings/bonds, then keep running.
      Use only for recovery and immediately flash normal firmware afterward.
```

## boards/shields/xiao_ble_proxy/Kconfig.defconfig
```kconfig
if SHIELD_XIAO_BLE_PROXY

config ZMK_KEYBOARD_NAME
    default "XIAO Proxy"

config ZMK_BLE_HOGP_SNIFFER
    default y

config ZMK_BLE_HOGP_SNIFFER_TARGET_MAC
    default "dd:75:7b:9c:8a:1f"

config ZMK_BLE_HOGP_SNIFFER_TARGET_ADDR_TYPE_PUBLIC
    default n

config ZMK_BLE_HOGP_SNIFFER_AUTO_SELECT_NAME_CONTAINS
    default "kobito"

endif
```

## boards/shields/xiao_ble_proxy/Kconfig.shield
```kconfig
config SHIELD_XIAO_BLE_PROXY
    def_bool $(shields_list_contains,xiao_ble_proxy)
```

## dts/bindings/kscan/zmk,kscan-hogp-proxy.yaml
```yaml
description: ZMK HOGP proxy virtual kscan

compatible: "zmk,kscan-hogp-proxy"

include: base.yaml

properties:
  rows:
    type: int
    required: true
    description: Number of rows in the virtual matrix

  columns:
    type: int
    required: true
    description: Number of columns in the virtual matrix

  input-gpios:
    type: phandle-array
    required: true
    description: GPIO inputs for external tact switches (P0..P3)
```
